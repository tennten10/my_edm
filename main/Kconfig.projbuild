## main/Kconfig.projbuild
```kconfig
# Kconfig file for SUDOCHEF board prototypes

menu "AAA SUDOBOARD menu"

    config TESTOPTION_YAY
        bool "Enable test option"

    choice SB_DESIGN
        prompt "Select predefined display configuration"
        default SB_PREDEFINED_NONE
        help
            Select predefined SudoBoard display configuration


    endchoice

endmenu
```
